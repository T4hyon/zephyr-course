## app/Kconfig
```kconfig
config APP_HEARTBEAT_PERIOD_MS
  int "App heartbeat period time (ms)."
  range 100 2000
  default 500
  help 
    Time between application heartbeats in milliseconds.

menuconfig LED_SUBSYSTEM
  bool "LED Subsystem"
  default y

if LED_SUBSYSTEM

choice
  prompt "LED blink sleep time"
  default BLINK_SLEEP_1000MS

config BLINK_SLEEP_250MS
  bool "250ms (speedy)"

config BLINK_SLEEP_500MS
  bool "500ms (fast)"

config BLINK_SLEEP_1000MS
  bool "1s (medium)"

config BLINK_SLEEP_2000MS
  bool "2s (slow)"

endchoice

config BLINK_SLEEP_TIME_MS
  int
  default 250 if BLINK_SLEEP_250MS
  default 500 if BLINK_SLEEP_500MS
  default 1000 if BLINK_SLEEP_1000MS
  default 2000 if BLINK_SLEEP_2000MS
  default 0

menuconfig LED_ADV_SETTINGS
  bool "Advanced LED settings"
  default n

if LED_ADV_SETTINGS

config LED_BRIGHTNESS
  int "LED Brightness (0-100)"
  range 0 100
  default 100

config LED_FADE_DURATION
  int "LED fade duration (0-5000)"
  range 0 5000
  default 500

menu "LED_EXPERT_SETTINGS"
  visible if LED_ADV_SETTINGS

config LED_DEBUG
  bool "Enable LED Debugging"

config LED_CUSTOM_BLINK_PATTERN
  bool "Custom blink pattern"

endmenu

endif # LED_ADV_SETTINGS

endif # LED_SUBSYSTEM

source "Kconfig.zephyr"
```
